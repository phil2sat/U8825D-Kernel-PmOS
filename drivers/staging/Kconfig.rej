## drivers/staging/Kconfig.rej
```kconfig
--- drivers/staging/Kconfig
+++ drivers/staging/Kconfig
@@ -157,5 +157,7 @@ source "drivers/staging/westbridge/Kconfig"
 
 source "drivers/staging/sbe-2t3e3/Kconfig"
 
+source "drivers/staging/ath6kl/Kconfig"
+
 endif # !STAGING_EXCLUDE_BUILD
 endif # STAGING
```
